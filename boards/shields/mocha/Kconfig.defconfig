## boards/shields/mocha/Kconfig.defconfig
```kconfig
if SHIELD_MOCHA_LEFT

config ZMK_KEYBOARD_NAME
    default "Mocha"

config ZMK_SPLIT_ROLE_CENTRAL
    default y

endif

if SHIELD_MOCHA_LEFT || SHIELD_MOCHA_RIGHT

config ZMK_SPLIT
    default y

endif
```

## boards/shields/mocha/Kconfig.shield
```kconfig
# Copyright (c) 2020 Pete Johanson
# SPDX-License-Identifier: MIT

config SHIELD_MOCHA_LEFT
    def_bool $(shields_list_contains,mocha_left)

config SHIELD_MOCHA_RIGHT
    def_bool $(shields_list_contains,mocha_right)
```
